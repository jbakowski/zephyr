## tests/shc_cosim/Kconfig.sysbuild
```kconfig
# Copyright 2024 Intel Corporation
# SPDX-License-Identifier: Apache-2.0

source "share/sysbuild/Kconfig"

config HOST_BOARD
	string
	default "stm32l562e_dk"
```

## tests/shc_cosim/testcase.yaml
```yaml
tests:
  pm.state_transition_idle_to_active:
    platform_allow:
      - stm32l562e_dk
    tags:
      - pm
      - gpio
    harness: pytest
    harness_config:
      pytest_dut_scope: session
      pytest_root:
        - "pytest/test_idle_to_active_transition.py"
      pytest_args: [--host-uuid=004800483137510D33333639, --client-uuid=004E003F3137510B33333639, --host-board=stm32l562e_dk, --client-board=stm32l562e_dk, --powershield=/dev/serial/by-id/usb-STMicroelectronics_STLINK-V3_004800483137510D33333639-if02]
```
